## conf/machine/iot2050.conf
```bitbake
#
# Copyright (c) Siemens AG, 2019-2022
#
# Authors:
#  Le Jin <le.jin@siemens.com>
#  Su Baocheng <baocheng.su@siemens.com>
#
# This file is subject to the terms and conditions of the MIT License.  See
# COPYING.MIT file in the top-level directory.
#

DISTRO_ARCH ?= "arm64"

PRODUCT_GENERATION ?= "pg2"

PREFERRED_PROVIDER_u-boot-${MACHINE} ?= "u-boot-iot2050-${PRODUCT_GENERATION}"
PREFERRED_PROVIDER_u-boot-${MACHINE}-config ?= "u-boot-iot2050-${PRODUCT_GENERATION}"

KERNEL_NAME ?= "iot2050"
DTB_FILES ?= " \
    ti/k3-am6528-iot2050-basic.dtb \
    ti/k3-am6528-iot2050-basic-pg2.dtb \
    ti/k3-am6548-iot2050-advanced.dtb \
    ti/k3-am6548-iot2050-advanced-pg2.dtb \
    ti/k3-am6548-iot2050-advanced-m2.dtb \
    "

IMAGE_FSTYPES ?= "wic"
WKS_FILE ?= "iot2050.wks.in"

IMAGE_INSTALL += "u-boot-script"

# only relevant for SWUpdate image
SWUPDATE_BOOTLOADER = "efibootguard"

CONSOLE_KERNEL_PARAMS ?= "console=ttyS3,115200n8 earlycon=ns16550a,mmio32,0x02810000"
```

## meta-example/conf/distro/iot2050-example.conf
```bitbake
#
# Copyright (c) Siemens AG, 2025
#
# Authors:
#  Li Hua Qian <huaqian.li@siemens.com>
#
# SPDX-License-Identifier: MIT
#

require conf/distro/iot2050-debian.conf
require conf/include/iot2050-features.inc

SDK_INSTALL += "mraa"
```

## meta-example/conf/layer.conf
```bitbake
#
# IoT2050 Example/Demo Layer Configuration
#
# Copyright (c) Siemens AG, 2025
#
# Authors:
#  Li Hua Qian <huaqian.li@siemens.com>
#
# SPDX-License-Identifier: MIT
#

BBPATH .= ":${LAYERDIR}"

BBFILES += "${LAYERDIR}/recipes-*/*/*.bb \
        ${LAYERDIR}/recipes-*/*/*.bbappend"

BBFILE_COLLECTIONS += "meta-example"
BBFILE_PATTERN_meta-example = "^${LAYERDIR}/"
BBFILE_PRIORITY_meta-example = "7"

LAYERSERIES_COMPAT_meta-example = "next"

LAYERDIR_meta-example = "${LAYERDIR}"
LAYERDIR_meta-example[vardepvalue] = "meta-example"

LAYERDEPENDS_meta-example = "meta"
```

## meta-hailo/conf/layer.conf
```bitbake
# SPDX-FileCopyrightText: Copyright 2023-2024 Siemens AG
# SPDX-License-Identifier: MIT
BBPATH .= ":${LAYERDIR}"

BBFILES += "${LAYERDIR}/recipes-*/*/*.bb \
            ${LAYERDIR}/recipes-*/*/*.bbappend"

BBFILE_COLLECTIONS += "hailo"
BBFILE_PATTERN_hailo = "^${LAYERDIR}/recipes-"
BBFILE_PRIORITY_hailo = "6"
LAYERVERSION_hailo = "3"

LAYERSERIES_COMPAT_hailo = "next"

LAYERDIR_hailo = "${LAYERDIR}"
```

## meta-node-red/conf/layer.conf
```bitbake
#
# IoT2050 Node-RED Layer Configuration
#
# Copyright (c) Siemens AG, 2025
#
# Authors:
#  Li Hua Qian <huaqian.li@siemens.com>
#
# SPDX-License-Identifier: MIT
#

BBPATH .= ":${LAYERDIR}"

BBFILES += "${LAYERDIR}/recipes-*/*/*.bb \
        ${LAYERDIR}/recipes-*/*/*.bbappend"

BBFILE_COLLECTIONS += "meta-node-red"
BBFILE_PATTERN_meta-node-red = "^${LAYERDIR}/"
BBFILE_PRIORITY_meta-node-red = "6"

LAYERSERIES_COMPAT_meta-node-red = "next"

LAYERDIR_meta-node-red = "${LAYERDIR}"
LAYERDIR_meta-node-red[vardepvalue] = "meta-node-red"

require recipes-core/images/meta-node-red-packages.inc
```

## meta-sm/conf/layer.conf
```bitbake
#
# IoT2050-SM Board Variant Layer Configuration
#
# Copyright (c) Siemens AG, 2025
#
# Authors:
#  Li Hua Qian <huaqian.li@siemens.com>
#
# SPDX-License-Identifier: MIT
#

BBPATH .= ":${LAYERDIR}"

BBFILES += "${LAYERDIR}/recipes-*/*/*.bb \
        ${LAYERDIR}/recipes-*/*/*.bbappend"

DTB_FILES += " \
    ti/k3-am6548-iot2050-advanced-sm.dtb \
    "

BBFILE_COLLECTIONS += "meta-sm"
BBFILE_PATTERN_meta-sm = "^${LAYERDIR}/"
BBFILE_PRIORITY_meta-sm = "6"

LAYERSERIES_COMPAT_meta-sm = "next"

LAYERDIR_meta-sm = "${LAYERDIR}"
LAYERDIR_meta-sm[vardepvalue] = "meta-sm"

require recipes-core/images/meta-sm-packages.inc
```

## meta/conf/layer.conf
```bitbake
#
# Copyright (c) Siemens AG, 2025
#
# Authors:
#  Li Hua Qian <huaqian.li@siemens.com>
#
# SPDX-License-Identifier: MIT
#

BBPATH .= ":${LAYERDIR}"

BBFILES += "${LAYERDIR}/recipes-*/*/*.bb \
            ${LAYERDIR}/recipes-*/*/*.bbappend"

BBFILE_COLLECTIONS += "meta"
BBFILE_PATTERN_meta = "^${LAYERDIR}/recipes-"
BBFILE_PRIORITY_meta = "6"
LAYERVERSION_meta = "3"

LAYERSERIES_COMPAT_meta = "next"

LAYERDIR_meta = "${LAYERDIR}"

ISAR_RELEASE_CMD = "git -C ${LAYERDIR_meta-iot2050} describe --long --tags --dirty --always || echo unknown"

require classes/git-timestamp.bbclass
SOURCE_DATE_EPOCH = "${@get_git_tag_timestamp(d)}"
```

## meta/conf/machine/iot2050-qemu.conf
```bitbake
#
# Copyright (c) Siemens AG, 2023
#
# Authors:
#  Enes Colpan <enes.colpan@siemens.com>
#
# This file is subject to the terms and conditions of the MIT License.  See
# COPYING.MIT file in the top-level directory.
#

require conf/machine/iot2050.conf

DTB_FILES = ""

CONSOLE_KERNEL_PARAMS = ""

QEMU_IMAGE = "1"

PREFERRED_PROVIDER_u-boot-${MACHINE} = "u-boot-qemu-arm64"
```

## meta/recipes-bsp/secure-boot-otp-provisioning/files/its/key-provision-3keys.its
```
/dts-v1/;

/include/ "include/key-provision-mpk-smpk.its"
/include/ "include/key-provision-bmpk.its"

/ {
    description = "IOT2050 secure boot OTP command data - MPK, SMPK, BMPK & Enabling";

    options {
        version = <1>;
        option-4 {
            cmd = "enable-secure-boot";
        };
    };
};
```

## meta/recipes-bsp/secure-boot-otp-provisioning/files/its/key-provision.its
```
/dts-v1/;

/include/ "include/key-provision-mpk-smpk.its"

/ {
    description = "IOT2050 secure boot OTP command data - MPK, SMPK & Enabling";

    options {
        version = <1>;
        option-3 {
            cmd = "enable-secure-boot";
        };
    };
};
```

## meta/recipes-bsp/secure-boot-otp-provisioning/files/its/key-switch.its
```
/dts-v1/;

/ {
    description = "IOT2050 secure boot OTP command data - Key Switching";
    creator = "IOT2050 secure boot OTP provisioning tool";

    images {
    };

    options {
        version = <1>;
        option-1 {
            cmd = "switch-customer-key-hash";
        };
    };
};
```

## recipes-bsp/secure-boot-otp-provisioning/files/its/key-provision-enabling-only.its
```
/dts-v1/;

/ {
    description = "IOT2050 secure boot OTP command data - Only Enabling";
    creator = "IOT2050 secure boot OTP provisioning tool";

    images {
    };

    options {
        version = <1>;
        option-1 {
            cmd = "enable-secure-boot";
        };
    };
};
```

## wic/iot2050-swu.wks
```
#
# Copyright (c) Siemens AG, 2021
#
# Authors:
#  Quirin Gylstorff <quirin.gylstorff@siemens.com>
#
# This file is subject to the terms and conditions of the MIT License.  See
# COPYING.MIT file in the top-level directory.
#

bootloader --ptable gpt --append "console=ttyS3,115200n8 earlycon=ns16550a,mmio32,0x02810000 mtdparts=47040000.spi.0:512k(ospi.tiboot3),2m(ospi.tispl),4m(ospi.u-boot),128k(ospi.env),128k(ospi.env.backup),1m(ospi.sysfw),64k(pru0-fw),64k(pru1-fw),64k(rtu0-fw),64k(rtu1-fw),-@8m(ospi.rootfs) rw rootwait"

# rootfs A
part --source rootfs-u-boot --sourceparams="no_initrd=yes,script_prepend=if test \\\"\${board_name}\\\" = \\\"IOT2050-ADVANCED\\\"; then set fdtfile ti/k3-am6548-iot2050-advanced-oldfw.dtb; else setenv fdtfile ti/k3-am6528-iot2050-basic-oldfw.dtb; fi;env exists partnum || setenv partnum 0;env exists sysselect || setenv sysselect 1,root=/dev/mmcblk\${partnum}p\${sysselect}" --extra-space 128M --fstype ext4 --label rootfsa --align 1024

# rootf B
part --source rootfs-u-boot --sourceparams="no_initrd=yes,script_prepend=if test \\\"\${board_name}\\\" = \\\"IOT2050-ADVANCED\\\"; then set fdtfile ti/k3-am6548-iot2050-advanced-oldfw.dtb; else setenv fdtfile ti/k3-am6528-iot2050-basic-oldfw.dtb; fi;env exists partnum || setenv partnum 0;env exists sysselect || setenv sysselect 1,root=/dev/mmcblk\${partnum}p\${sysselect}" --extra-space 128M --fstype ext4 --label rootfsb --align 1024
```

## wic/iot2050.wks
```
#
# Copyright (c) Siemens AG, 2019
#
# Authors:
#  Le Jin <le.jin@siemens.com>
#
# This file is subject to the terms and conditions of the MIT License.  See
# COPYING.MIT file in the top-level directory.
#

part / --source rootfs-u-boot --sourceparams="no_initrd=yes,script_prepend=env exists fdtfile || if test \${board_name} = IOT2050-ADVANCED; then set fdtfile siemens/iot2050-advanced.dtb; else setenv fdtfile siemens/iot2050-basic-oldfw.dtb; fi" --fstype ext4 --label rootfs --align 1024 --use-uuid

bootloader --ptable gpt --append "console=ttyS3,115200n8 earlycon=ns16550a,mmio32,0x02810000 mtdparts=47040000.spi.0:512k(ospi.tiboot3),2m(ospi.tispl),4m(ospi.u-boot),128k(ospi.env),128k(ospi.env.backup),1m(ospi.sysfw),64k(pru0-fw),64k(pru1-fw),64k(rtu0-fw),64k(rtu1-fw),-@8m(ospi.rootfs) rw rootwait"
```
